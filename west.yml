## west.yml
```yaml
manifest:
  remotes:
    - name: ncs
      url-base: https://github.com/nrfconnect
  projects:
    - name: nrf
      repo-path: sdk-nrf
      remote: ncs
      revision: 03357d46827dcea2ed76042b912221af0c587d01
      import: true
    - name: zephyr-my-boards
      url: https://github.com/fgervais/zephyr-my-boards
      revision: 0d81726056a7639f0c8313cd625c72adfc040c45
      path: myboards
    - name: zephyr-mymodule-base
      url: https://github.com/fgervais/zephyr-mymodule-base.git
      revision: 98ec30348d89a774459b8e4d6e46bf9eedd9df44
      path: mymodules/base
  self:
    path: application
```
